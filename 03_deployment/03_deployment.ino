/*
  03_deployment.ino — Aqua Milk Detect, Stage 3: the finished standalone tester.
  ESP32 DevKit V1 (arduino-esp32 core). Runs the trained SVM on-device, shows the
  verdict on the TFT, serves its own Wi-Fi dashboard, self-flushes, driven by one
  TTP223 pad, with soft-power deep sleep.

  ------------------------------------------------------------------- gestures (§7)
    single tap ............ run a test
    double tap ............ flush now
    long press ~1.5 s ..... on-screen menu (tap = next item, double tap = select,
                            long press = exit). Items: Wi-Fi info, Tare,
                            Re-check calibration, Settings, Gestures, Exit.
    tap, tap, hold ........ soft power: deep sleep. Touch wakes it (ext0 on GPIO27).

  ------------------------------------------------------------------ HTTP endpoints
    GET  /                  gzipped dashboard from PROGMEM (dashboard.h)
    GET  /api/state         settings + Wi-Fi + last verdict + model status
    GET  /api/log           rolling log from LittleFS  {"rows":[{ms,cls,conf,ph,...}]}
    POST /api/test          start a test
    POST /api/flush         flush now
    POST /api/tare          zero the load cell
    POST /api/selftest      all-sensors health check -> {"ok":bool,"why":".."}
    POST /api/settings      ?thr=&flush_ms=&avg_ms=
    POST /api/wifi          ?mode=ap|sta&ssid=&pass=   (saves, then reboots)
    POST /api/factory_reset clears NVS calibration + settings + Wi-Fi, wipes the log

  ---------------------------------------------------------------- WebSocket /ws
    {"t":"reading", ph,tds,turb,temp,dens,r,g,b,c, calc:{ph,ppm,ntu,sg}}   ~2 Hz
    {"t":"status",  state:"idle"|"testing"|"flushing"}
    {"t":"result",  cls, conf, uncertain, adulterated, p_adult, probs{}, z[], reason, ms}

  ------------------------------------------------------------------- feature order
    [ph, tds, turbidity, density, temperature, color_r, color_g, color_b, color_clear]
    Defined once in libs/AquaMilkSensors/src/features.h and mirrored by the trainer.
    model.h + scaler.h are generated by training/train.py; the committed ones are
    placeholders that always answer "Uncertain" (MODEL_IS_PLACEHOLDER).

  Timestamps are milliseconds since boot — there is no RTC on the board, so the
  dashboard renders them as relative times instead of pretending to know the date.

  Libraries: pinned set from 01_calibration plus ESP Async WebServer 3.12.0 +
  Async TCP 3.4.9 (ESP32Async). Shared sensor code: libs/AquaMilkSensors.
*/

#include <WiFi.h>
#include <ESPmDNS.h>
#include <LittleFS.h>
#include <Preferences.h>
#include <ArduinoJson.h>
#include <ESPAsyncWebServer.h>
#include <esp_sleep.h>

#include <sensors.h>
#include <display.h>
#include "svm_infer.h"
#include "dashboard.h"

#define FW_NAME "03_deployment"
#define FW_VER  "1.0.0"

#define LOG_PATH  "/log.csv"
#define LOG_KEEP  200          // rolling log length (§11)

// ------------------------------------------------------------------ app state
enum AppState { IDLE, TESTING, FLUSHING, MENU };
static AppState  app = IDLE;
static AsyncWebServer server(80);
static AsyncWebSocket ws("/ws");
static Preferences net_prefs;

static Verdict  last_v;
static bool     have_result = false;
static uint32_t last_ms = 0;
static char     reason[64] = "";

static String   ap_ssid, ap_pass, sta_ssid, sta_pass, ip_str;
static bool     sta_mode = false;
static uint32_t t_push = 0, t_tft = 0;

// menu
static const char* MENU_ITEMS[] = { "Wi-Fi info", "Tare", "Re-check cal",
                                    "Settings", "Gestures", "Exit" };
static const uint8_t MENU_N = sizeof(MENU_ITEMS) / sizeof(MENU_ITEMS[0]);
static uint8_t menu_i = 0;
static char    menu_note[40] = "";

// ------------------------------------------------------------------- log (fs)
static void logAppend(const Verdict& v, const Reading& r) {
  File f = LittleFS.open(LOG_PATH, FILE_APPEND);
  if (!f) return;
  f.printf("%lu,%s,%.3f,%.0f,%.0f,%.0f,%.4f,%.1f\n",
           (unsigned long)millis(),
           v.uncertain ? "uncertain" : CLASS_NAMES[v.cls],
           v.conf, r.ph_mv, r.tds_mv, r.turb_mv,
           specificGravity(r.density_g, r.temp_c), r.temp_c);
  size_t sz = f.size();
  f.close();

  if (sz < 12000) return;             // ~240 rows of ~50 B — trimming is rare
  File in = LittleFS.open(LOG_PATH, FILE_READ);
  if (!in) return;
  String all = in.readString();
  in.close();
  int keep_from = 0, seen = 0;
  for (int i = all.length() - 1; i >= 0; i--) {
    if (all[i] == '\n') {
      seen++;
      if (seen > LOG_KEEP) { keep_from = i + 1; break; }
    }
  }
  File out = LittleFS.open(LOG_PATH, FILE_WRITE);
  if (out) { out.print(all.substring(keep_from)); out.close(); }
}

static void logToJson(String& out) {
  out = "{\"rows\":[";
  File f = LittleFS.open(LOG_PATH, FILE_READ);
  if (f) {
    bool first = true;
    while (f.available()) {
      String line = f.readStringUntil('\n');
      line.trim();
      if (line.length() < 5) continue;
      int c[7], n = 0;
      for (int i = 0; i < (int)line.length() && n < 7; i++) if (line[i] == ',') c[n++] = i;
      if (n < 7) continue;
      if (!first) out += ",";
      first = false;
      out += "{\"ms\":" + line.substring(0, c[0]) +
             ",\"cls\":\"" + line.substring(c[0] + 1, c[1]) + "\"" +
             ",\"conf\":" + line.substring(c[1] + 1, c[2]) +
             ",\"ph\":" + line.substring(c[2] + 1, c[3]) +
             ",\"tds\":" + line.substring(c[3] + 1, c[4]) +
             ",\"turb\":" + line.substring(c[4] + 1, c[5]) +
             ",\"sg\":" + line.substring(c[5] + 1, c[6]) +
             ",\"temp\":" + line.substring(c[6] + 1) + "}";
    }
    f.close();
  }
  out += "]}";
}

// --------------------------------------------------------------------- pushes
static void pushStatus() {
  JsonDocument d;
  d["t"] = "status";
  d["state"] = app == TESTING ? "testing" : app == FLUSHING ? "flushing" : "idle";
  String s;
  serializeJson(d, s);
  ws.textAll(s);
}

static void fillReading(JsonDocument& d) {
  const Reading& r = sensorsLatest();
  d["t"] = "reading";
  d["ph"] = r.ph_mv; d["tds"] = r.tds_mv; d["turb"] = r.turb_mv;
  d["temp"] = r.temp_c; d["dens"] = r.density_g;
  d["r"] = r.r; d["g"] = r.g; d["b"] = r.b; d["c"] = r.c;
  JsonObject calc = d["calc"].to<JsonObject>();
  float ph = phFromMv(r.ph_mv);
  if (isnan(ph)) calc["ph"] = nullptr; else calc["ph"] = ph;
  calc["ppm"] = tdsPpm(r.tds_mv, r.temp_c);
  calc["ntu"] = turbidityNtu(r.turb_mv);
  calc["sg"]  = specificGravity(r.density_g, r.temp_c);
}

static void fillResult(JsonDocument& d) {
  d["t"] = "result";
  d["cls"] = last_v.uncertain ? "uncertain" : CLASS_NAMES[last_v.cls];
  d["conf"] = last_v.conf;
  d["uncertain"] = last_v.uncertain;
  d["adulterated"] = last_v.adulterated;
  d["p_adult"] = probAdulterated(last_v);
  d["reason"] = reason;
  d["ms"] = last_ms;
  JsonObject p = d["probs"].to<JsonObject>();
  for (uint8_t c = 0; c < CLASS_COUNT; c++) p[CLASS_NAMES[c]] = last_v.prob[c];
  JsonArray z = d["z"].to<JsonArray>();
  for (uint8_t f = 0; f < FEATURE_COUNT; f++) z.add(last_v.z[f]);
}

static void pushReading() {
  JsonDocument d;
  fillReading(d);
  String s;
  serializeJson(d, s);
  ws.textAll(s);
}

static void pushResult() {
  JsonDocument d;
  fillResult(d);
  String s;
  serializeJson(d, s);
  ws.textAll(s);
}

// ------------------------------------------------------------------------ TFT
static void tftIdle() {
  static char l_ssid[26], l_ip[26], l_pass[26];
  snprintf(l_ssid, sizeof l_ssid, "%s", (sta_mode ? sta_ssid : ap_ssid).c_str());
  snprintf(l_ip,   sizeof l_ip,   "%s", ip_str.c_str());
  snprintf(l_pass, sizeof l_pass, "%s", sta_mode ? "aquamilk.local" : ap_pass.c_str());
  const char* lines[] = { "Tap to test", "", sta_mode ? "Wi-Fi (joined):" : "Wi-Fi (own AP):",
                          l_ssid, l_pass, l_ip, "",
#if MODEL_IS_PLACEHOLDER
                          "model: PLACEHOLDER"
#else
                          "model: ready"
#endif
                        };
  dispLines(lines, sizeof(lines) / sizeof(lines[0]));
}

static void tftVerdict() {
  uint16_t col = last_v.uncertain ? AMD_AMBER : (last_v.adulterated ? AMD_RED : AMD_GREEN);
  char sub[40];
  snprintf(sub, sizeof sub, "%d%% confident", (int)lroundf(last_v.conf * 100));
  const char* word = last_v.uncertain ? "Uncertain" : CLASS_NAMES[last_v.cls];
  dispBig(word, col, sub);
  Adafruit_ST7735& t = dispTft();
  t.setTextSize(1);
  t.setTextColor(AMD_MUTED);
  t.setCursor(4, 112);
  t.print(last_v.uncertain ? "retest / flush" : (last_v.adulterated ? "ADULTERATED" : "PURE"));
  t.setCursor(4, 126);
  t.print(reason);
}

static void tftMenu() {
  const char* lines[MENU_N + 3];
  static char rows[MENU_N][26];
  uint8_t n = 0;
  lines[n++] = "Menu  tap=next";
  lines[n++] = "dbl=pick hold=exit";
  for (uint8_t i = 0; i < MENU_N; i++) {
    snprintf(rows[i], sizeof rows[i], "%s%s", i == menu_i ? "> " : "  ", MENU_ITEMS[i]);
    lines[n++] = rows[i];
  }
  lines[n++] = menu_note;
  dispLines(lines, n);
}

// ------------------------------------------------------------------ test flow
static void startTest() {
  if (app != IDLE) return;
  app = TESTING;
  avgStart(cal.avg_ms);
  dispBig("Reading", AMD_ACCENT, "hold still");
  pushStatus();
}

static void finishTest() {
  AveragedSample s = avgFinish();
  if (!s.ok) { app = IDLE; pushStatus(); return; }

  last_v = svmClassify(s.mean, cal.conf_threshold);
  last_ms = millis();
  have_result = true;
#if MODEL_IS_PLACEHOLDER
  snprintf(reason, sizeof reason, "no model on device");
#else
  snprintf(reason, sizeof reason, "%s %+.1f sd, %s %+.1f sd",
           FEATURE_NAMES[last_v.top_feat[0]], last_v.z[last_v.top_feat[0]],
           FEATURE_NAMES[last_v.top_feat[1]], last_v.z[last_v.top_feat[1]]);
#endif

  logAppend(last_v, sensorsLatest());
  pushResult();
  tftVerdict();

  pumpStart(cal.flush_ms);          // auto-flush, then back to idle (§7)
  app = FLUSHING;
  pushStatus();
}

// ------------------------------------------------------------------- gestures
// One TTP223 on GPIO27, active high. Timing windows are deliberately generous.
#define LONG_MS 1500
#define GAP_MS   500
static bool     t_down = false;
static uint32_t t_edge = 0, t_last_release = 0;
static uint8_t  tap_run = 0;          // consecutive short taps
static bool     long_fired = false;

static void onTap();
static void onDoubleTap();
static void onLongPress();
static void onSoftPower();

static void touchUpdate() {
  bool now_down = digitalRead(PIN_TOUCH) == HIGH;
  uint32_t now = millis();

  if (now_down != t_down) {
    if (now - t_edge < 30) return;                        // debounce
    t_down = now_down;
    t_edge = now;
    if (now_down) {
      long_fired = false;
      if (now - t_last_release > GAP_MS) tap_run = 0;     // stale run
    } else if (!long_fired) {
      tap_run++;                                         // a short tap landed
      t_last_release = now;
    } else {
      tap_run = 0;                                       // release after a long press
    }
    return;
  }

  if (t_down && !long_fired && now - t_edge >= LONG_MS) {
    long_fired = true;
    if (tap_run >= 2) { tap_run = 0; onSoftPower(); }     // tap, tap, hold
    else              { tap_run = 0; onLongPress(); }
    return;
  }

  if (!t_down && tap_run > 0 && now - t_last_release >= GAP_MS) {
    uint8_t n = tap_run;
    tap_run = 0;
    if (n == 1) onTap();
    else        onDoubleTap();
  }
}

static void onTap() {
  if (app == MENU) { menu_i = (menu_i + 1) % MENU_N; menu_note[0] = 0; tftMenu(); return; }
  if (app == IDLE) startTest();
}

static void onDoubleTap() {
  if (app == MENU) {
    const char* item = MENU_ITEMS[menu_i];
    if (!strcmp(item, "Tare")) {
      calTare();
      snprintf(menu_note, sizeof menu_note, "chamber zeroed");
    } else if (!strcmp(item, "Re-check cal")) {
      Reading r;
      char why[80];
      bool ok = sensorsSelftest(r, why, sizeof why);
      snprintf(menu_note, sizeof menu_note, "%s", ok ? "all sensors ok" : why);
    } else if (!strcmp(item, "Settings")) {
      snprintf(menu_note, sizeof menu_note, "thr %.2f flush %us",
               cal.conf_threshold, (unsigned)(cal.flush_ms / 1000));
    } else if (!strcmp(item, "Wi-Fi info")) {
      snprintf(menu_note, sizeof menu_note, "%s", ip_str.c_str());
    } else if (!strcmp(item, "Gestures")) {
      snprintf(menu_note, sizeof menu_note, "tap dbl hold tap-tap-hold");
    } else if (!strcmp(item, "Exit")) {
      app = IDLE;
      tftIdle();
      return;
    }
    tftMenu();
    return;
  }
  if (app == IDLE) { pumpStart(cal.flush_ms); app = FLUSHING; pushStatus(); }
}

static void onLongPress() {
  if (app == MENU) { app = IDLE; tftIdle(); return; }
  if (app == IDLE) { app = MENU; menu_i = 0; menu_note[0] = 0; tftMenu(); }
}

static void onSoftPower() {
  dispBig("Sleeping", AMD_MUTED, "touch to wake");
  ws.closeAll();
  pumpStop();
  delay(600);
  WiFi.disconnect(true);
  WiFi.mode(WIFI_OFF);
  dispTft().enableDisplay(false);
  esp_sleep_enable_ext0_wakeup((gpio_num_t)PIN_TOUCH, 1);   // wake on touch (§7)
  esp_deep_sleep_start();
}

// ---------------------------------------------------------------------- Wi-Fi
static void netLoad() {
  net_prefs.begin("amd_net", true);
  sta_ssid = net_prefs.getString("ssid", "");
  sta_pass = net_prefs.getString("pass", "");
  sta_mode = net_prefs.getBool("sta", false) && sta_ssid.length() > 0;
  net_prefs.end();
}

static void netStart() {
  uint8_t mac[6];
  WiFi.macAddress(mac);
  char id[5];
  snprintf(id, sizeof id, "%02X%02X", mac[4], mac[5]);
  ap_ssid = String("AquaMilk-") + id;
  ap_pass = String("aqua-") + id;          // 9 chars, shown on the TFT

  if (sta_mode) {
    WiFi.mode(WIFI_STA);
    WiFi.begin(sta_ssid.c_str(), sta_pass.c_str());
    uint32_t t0 = millis();
    while (WiFi.status() != WL_CONNECTED && millis() - t0 < 12000) delay(200);
    if (WiFi.status() == WL_CONNECTED) {
      ip_str = WiFi.localIP().toString();
      if (MDNS.begin("aquamilk")) MDNS.addService("http", "tcp", 80);
      return;
    }
    sta_mode = false;                       // fall back so the device is never unreachable
  }
  WiFi.mode(WIFI_AP);
  WiFi.softAP(ap_ssid.c_str(), ap_pass.c_str());
  ip_str = WiFi.softAPIP().toString();
}

// -------------------------------------------------------------------- HTTP API
static float argF(AsyncWebServerRequest* q, const char* k, float dflt) {
  if (q->hasParam(k, true))  return q->getParam(k, true)->value().toFloat();
  if (q->hasParam(k, false)) return q->getParam(k, false)->value().toFloat();
  return dflt;
}

static String argS(AsyncWebServerRequest* q, const char* k) {
  if (q->hasParam(k, true))  return q->getParam(k, true)->value();
  if (q->hasParam(k, false)) return q->getParam(k, false)->value();
  return String();
}

static void routes() {
  server.on("/", HTTP_GET, [](AsyncWebServerRequest* q) {
    AsyncWebServerResponse* res = q->beginResponse(200, "text/html",
                                                   DASHBOARD_HTML_GZ, DASHBOARD_HTML_GZ_LEN);
    res->addHeader("Content-Encoding", "gzip");
    q->send(res);
  });

  server.on("/api/state", HTTP_GET, [](AsyncWebServerRequest* q) {
    JsonDocument d;
    d["state"] = app == TESTING ? "testing" : app == FLUSHING ? "flushing" : "idle";
    d["thr"] = cal.conf_threshold;
    d["flush_ms"] = cal.flush_ms;
    d["avg_ms"] = cal.avg_ms;
    d["placeholder"] = (bool)MODEL_IS_PLACEHOLDER;
    d["fw"] = FW_VER;
    d["uptime_ms"] = millis();
    JsonObject w = d["wifi"].to<JsonObject>();
    w["mode"] = sta_mode ? "sta" : "ap";
    w["ssid"] = sta_mode ? sta_ssid : ap_ssid;
    w["ip"] = ip_str;
    if (have_result) {
      JsonDocument r;
      fillResult(r);
      d["last"] = r;
    }
    String s;
    serializeJson(d, s);
    q->send(200, "application/json", s);
  });

  server.on("/api/log", HTTP_GET, [](AsyncWebServerRequest* q) {
    String s;
    logToJson(s);
    q->send(200, "application/json", s);
  });

  server.on("/api/test", HTTP_POST, [](AsyncWebServerRequest* q) {
    bool ok = (app == IDLE);
    if (ok) startTest();
    q->send(200, "application/json", ok ? "{\"ok\":true}" : "{\"ok\":false,\"msg\":\"busy\"}");
  });

  server.on("/api/flush", HTTP_POST, [](AsyncWebServerRequest* q) {
    bool ok = (app == IDLE);
    if (ok) { pumpStart(cal.flush_ms); app = FLUSHING; pushStatus(); }
    q->send(200, "application/json", ok ? "{\"ok\":true}" : "{\"ok\":false,\"msg\":\"busy\"}");
  });

  server.on("/api/tare", HTTP_POST, [](AsyncWebServerRequest* q) {
    calTare();
    q->send(200, "application/json", "{\"ok\":true}");
  });

  server.on("/api/selftest", HTTP_POST, [](AsyncWebServerRequest* q) {
    Reading r;
    char why[80];
    bool ok = sensorsSelftest(r, why, sizeof why);
    JsonDocument d;
    d["ok"] = ok;
    d["why"] = why;
    String s;
    serializeJson(d, s);
    q->send(200, "application/json", s);
  });

  server.on("/api/settings", HTTP_POST, [](AsyncWebServerRequest* q) {
    cal.conf_threshold = constrain(argF(q, "thr", cal.conf_threshold), 0.0f, 0.99f);
    cal.flush_ms = (uint16_t)constrain(argF(q, "flush_ms", cal.flush_ms), 0.0f, 60000.0f);
    cal.avg_ms   = (uint16_t)constrain(argF(q, "avg_ms",   cal.avg_ms), 200.0f, 20000.0f);
    calSave();
    q->send(200, "application/json", "{\"ok\":true}");
  });

  server.on("/api/wifi", HTTP_POST, [](AsyncWebServerRequest* q) {
    String mode = argS(q, "mode");
    net_prefs.begin("amd_net", false);
    net_prefs.putBool("sta", mode == "sta");
    if (mode == "sta") {
      net_prefs.putString("ssid", argS(q, "ssid"));
      net_prefs.putString("pass", argS(q, "pass"));
    }
    net_prefs.end();
    q->send(200, "application/json", "{\"ok\":true,\"msg\":\"rebooting\"}");
    delay(300);
    ESP.restart();
  });

  server.on("/api/factory_reset", HTTP_POST, [](AsyncWebServerRequest* q) {
    calFactoryReset();
    net_prefs.begin("amd_net", false);
    net_prefs.clear();
    net_prefs.end();
    LittleFS.remove(LOG_PATH);
    q->send(200, "application/json", "{\"ok\":true,\"msg\":\"rebooting\"}");
    delay(300);
    ESP.restart();
  });

  server.onNotFound([](AsyncWebServerRequest* q) { q->send(404, "text/plain", "not found"); });
}

static void onWsEvent(AsyncWebSocket*, AsyncWebSocketClient* c, AwsEventType type,
                      void*, uint8_t*, size_t) {
  if (type == WS_EVT_CONNECT) {
    JsonDocument d;
    fillReading(d);
    String s;
    serializeJson(d, s);
    c->text(s);
    pushStatus();
    if (have_result) pushResult();
  }
}

// ---------------------------------------------------------------------- setup
void setup() {
  Serial.begin(115200);
  delay(150);
  Serial.printf("# Aqua Milk Detect %s v%s (%s %s)\n", FW_NAME, FW_VER, __DATE__, __TIME__);
#if MODEL_IS_PLACEHOLDER
  Serial.println("# WARNING: placeholder model — every test reports Uncertain until you train.");
#endif

  pinMode(PIN_TOUCH, INPUT);
  dispBegin("Aqua Milk Detect");
  sensorsBegin();

  if (!LittleFS.begin(true)) Serial.println("# LittleFS mount failed (log disabled)");

  netLoad();
  netStart();
  Serial.printf("# %s  http://%s\n", sta_mode ? sta_ssid.c_str() : ap_ssid.c_str(), ip_str.c_str());

  ws.onEvent(onWsEvent);
  server.addHandler(&ws);
  routes();
  server.begin();

  tftIdle();
}

void loop() {
  sensorsUpdate();
  touchUpdate();
  ws.cleanupClients();

  if (app == TESTING && !avgBusy()) finishTest();
  if (app == FLUSHING && !pumpBusy()) {
    app = IDLE;
    pushStatus();
    if (have_result && last_v.uncertain) dispBig("Uncertain", AMD_AMBER, "retest");
    else tftIdle();
  }

  uint32_t now = millis();
  if (now - t_push >= 500) { t_push = now; pushReading(); }              // ~2 Hz
  if (app == IDLE && now - t_tft >= 5000) { t_tft = now; tftIdle(); }
}
